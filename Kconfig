## Kconfig
```kconfig
# SPDX-License-Identifier: MIT
config ZMK_BEHAVIOR_OLED_SLEEP
    bool "OLED Sleep Toggle Behavior"
    depends on ZMK_BEHAVIOR  # ← 关键！确保 ZMK_BEHAVIOR 已启用
    default y
    help
      Adds a behavior to toggle OLED display on/off.
```

## dts/bindings/behaviors/zmk,behavior-oled-sleep.yaml
```yaml
# dts/bindings/behaviors/zmk,behavior-oled-sleep.yaml
description: OLED Sleep Toggle Behavior

compatible: "zmk,behavior-oled-sleep"

include: zero_param.yaml
```
